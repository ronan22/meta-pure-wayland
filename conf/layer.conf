## conf/layer.conf
```bitbake
# We have a conf and classes directory, add to BBPATH
BBPATH := "${BBPATH}:${LAYERDIR}"

# We have a packages directory, add to BBFILES
BBFILES := "${BBFILES} \
            ${LAYERDIR}/recipes-*/*/*.bb \
            ${LAYERDIR}/recipes-*/*/*.bbappend"

BBFILE_COLLECTIONS += "pure-wayland"
BBFILE_PATTERN_pure-wayland = "^${LAYERDIR}/"
BBFILE_PRIORITY_pure-wayland = "11"
```
